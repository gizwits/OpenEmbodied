## components/vb6824/Kconfig
```kconfig
menu "VB6824"
	choice VB6824_TYPE
    prompt "VB6924"
    default VB6824_TYPE_OPUS_16K_20MS_PCM_16K
    help
        VB6824支持的类型
    config VB6824_TYPE_PCM_16K
        depends on !IDF_TARGET_ESP32C2
        bool "PCM 16K"
    config VB6824_TYPE_OPUS_16K_20MS_PCM_16K
        bool "OPUS 16K 20ms(input) + PCM 16K(output)"
	endchoice
    config VB6824_OTA_SUPPORT
        bool "6824支持升级"
        default n
        select HTTPD_WS_SUPPORT
    
    config VB6824_UART_PORT
        int "uart port"
        default 1

    config VB6824_UART_TASK_STACK_SIZE
        int "uart task stack size"
        default 3072 if IDF_TARGET_ESP32C2
        default 4096

    config VB6824_SEND_USE_TASK
        bool "send use task"
        default y

    config VB6824_SEND_TASK_STACK_SIZE
        int "send task stack size"
        depends on VB6824_SEND_USE_TASK
        default 2048

endmenu
```

## main/Kconfig.projbuild
```kconfig
menu "Xiaozhi Assistant"

config OTA_URL
    string "Default OTA URL"
    default "https://api.tenclass.net/xiaozhi/ota/"
    help
        The application will access this URL to check for new firmwares and server address.


choice
    prompt "Default Language"
    default LANGUAGE_ZH_CN
    help
        Select device display language

    config LANGUAGE_ZH_CN
        bool "Chinese"
    config LANGUAGE_ZH_CN_LVLIN
        bool "Chinese LVLIN"
    config LANGUAGE_ZH_TW
        bool "Chinese Traditional"
    config LANGUAGE_EN_US
        bool "English"
    config LANGUAGE_JA_JP
        bool "Japanese"
endchoice

config COZE_WEBSOCKET_URL
    string "Coze Websocket URL"
    default "ws://ws.coze.cn/v1/chat"
    help
        Communication with the Coze server through websocket after wake up.
        
config TMP_PRODUCT_TEST_WIFI
    string "Product Test WiFi"
    default ""
    help
        Product test WiFi for Gizwits.

config TMP_PRODUCT_TEST_WIFI_PASSWORD
    string "Product Test WiFi Password"
    default ""
    help
        Product test WiFi password for Gizwits.

config PRODUCT_TEST_WIFI
    string "Product Test WiFi"
    default ""
    help
        Product test WiFi for Gizwits.

config PRODUCT_TEST_WIFI_PASSWORD
    string "Product Test WiFi Password"
    default ""
    help
        Product test WiFi password for Gizwits.
        
config PRODUCT_KEY
    string "Product Key"
    default "f1029d2150c242a38c2088ecf6b92121"
    help
        Product key for Gizwits.
        
config PRODUCT_SECRET
    string "Product Secret"
    default "05677a80e5cb4cea958d45264e11df3e"
    help
        Product secret for Gizwits.

config WEBSOCKET_ACCESS_TOKEN
    depends on CONNECTION_TYPE_WEBSOCKET
    string "Websocket Access Token"
    default "test-token"
    help
        Access token for websocket communication.

choice BOARD_TYPE
    prompt "Board Type"
    default BOARD_TYPE_BREAD_COMPACT_WIFI
    help
        Board type. 开发板类型
    config BOARD_TYPE_BREAD_COMPACT_WIFI
        bool "面包板新版接线（WiFi）"
    config BOARD_TYPE_BREAD_COMPACT_WIFI_LCD
        bool "面包板新版接线（WiFi）+ LCD"
    config BOARD_TYPE_BREAD_COMPACT_ML307
        bool "面包板新版接线（ML307 AT）"
    config BOARD_TYPE_BREAD_COMPACT_ESP32
        bool "面包板（WiFi） ESP32 DevKit"
    config BOARD_TYPE_BREAD_COMPACT_ESP32_LCD
        bool "面包板（WiFi+ LCD） ESP32 DevKit"
    config BOARD_TYPE_GIZWITS_GOKIT5
        bool "机智云ESP32-S3 Gokit5"
    config BOARD_TYPE_GIZWITS_LOTTIE
        bool "机智云ESP32-S3 Lottie"
    config BOARD_TYPE_GIZWITS_4KEY
        bool "机智云ESP32-S3 4键"
    config BOARD_TYPE_GIZWITS_4KEY_ML307
        bool "机智云ESP32-S3 4键ML307"
    config BOARD_TYPE_GIZWITS_C2_6824
        bool "机智云ESP32-C2 6824"
    config BOARD_TYPE_GIZWITS_C2_6824_CWH
        bool "机智云ESP32-C2 6824 cwh"
    config BOARD_TYPE_GIZWITS_C2_6824_LIGHT_ROBOT
        bool "机智云ESP32-C2 6824 光机器人"
    config BOARD_TYPE_GIZWITS_C2_6824_XINGBAO
        bool "机智云ESP32-C2 6824 星宝"
    config BOARD_TYPE_GIZWITS_C2_6824_ML307
        bool "机智云ESP32-C2 6824 ML307"
    config BOARD_TYPE_GIZWITS_C2_6824_LVLIN
        bool "机智云ESP32-C2 6824 绿林"
    config BOARD_TYPE_GIZWITS_C2_6824_TOY
        bool "机智云ESP32-C2 6824 玩具"
    config BOARD_TYPE_GIZWITS_C2_6824_DRF_W300CA
        bool "机智云ESP32-C2 6824 DRF-W300CA"
    config BOARD_TYPE_DOIT_AI_01_KIT
        bool "Doit ai 01 kit"
    config BOARD_TYPE_DOIT_AI_01_KIT_NFC
        bool "Doit ai 01 kit nfc"
    config BOARD_TYPE_DOIT_ESP32S3_EYE
        bool "Doit 小智眼"
    config BOARD_TYPE_DOIT_ESP32S3_EYE_6824
        bool "Doit 小智眼 6824"
    config BOARD_TYPE_GIZWITS_S3_VB6824_LCD
        bool "机智云ESP32-S3 6824 LCD"
    config BOARD_TYPE_GIZWITS_S3_VB6824_ST7735S
        bool "机智云ESP32-S3 6824 ST7735S"
    config BOARD_TYPE_ESP32S3_XUNGUAN_AMOLED_1_28
        bool "讯管"
    config BOARD_TYPE_ESP32S3_XUNGUAN_AMOLED_1_28_OLD
        bool "讯管old"
endchoice

choice ESP_S3_LCD_EV_Board_Version_TYPE
    depends on BOARD_TYPE_ESP_S3_LCD_EV_Board
    prompt "EV_BOARD Type"
    default ESP_S3_LCD_EV_Board_1p4
    help
        开发板硬件版本型号选择
    config ESP_S3_LCD_EV_Board_1p4
        bool "乐鑫ESP32_S3_LCD_EV_Board-MB_V1.4"
    config ESP_S3_LCD_EV_Board_1p5
        bool "乐鑫ESP32_S3_LCD_EV_Board-MB_V1.5"
endchoice

choice DISPLAY_OLED_TYPE
    depends on BOARD_TYPE_BREAD_COMPACT_WIFI || BOARD_TYPE_BREAD_COMPACT_ML307 || BOARD_TYPE_BREAD_COMPACT_ESP32
    prompt "OLED Type"
    default OLED_SSD1306_128X32
    help
        OLED 屏幕类型选择
    config OLED_SSD1306_128X32
        bool "SSD1306, 分辨率128*32"
    config OLED_SSD1306_128X64
        bool "SSD1306, 分辨率128*64"
    config OLED_SH1106_128X64
        bool "SH1106, 分辨率128*64"
endchoice

choice DISPLAY_LCD_TYPE
    depends on BOARD_TYPE_BREAD_COMPACT_WIFI_LCD || BOARD_TYPE_BREAD_COMPACT_ESP32_LCD || BOARD_TYPE_ESP32_CGC || BOARD_TYPE_DOIT_ESP32S3_EYE_6824 || BOARD_TYPE_DOIT_ESP32S3_EYE_8311
    prompt "LCD Type"
    default LCD_ST7789_240X320
    help
        屏幕类型选择
    config LCD_ST7789_240X320
        bool "ST7789, 分辨率240*320, IPS"
    config LCD_ST7789_240X320_NO_IPS
        bool "ST7789, 分辨率240*320, 非IPS"
    config LCD_ST7789_170X320
        bool "ST7789, 分辨率170*320"
    config LCD_ST7789_172X320
        bool "ST7789, 分辨率172*320"
    config LCD_ST7789_240X280
        bool "ST7789, 分辨率240*280"
    config LCD_ST7789_240X240
        bool "ST7789, 分辨率240*240"
    config LCD_ST7789_240X240_7PIN
        bool "ST7789, 分辨率240*240, 7PIN"
    config LCD_ST7789_240X135
        bool "ST7789, 分辨率240*135"
    config LCD_ST7735_128X160
        bool "ST7735, 分辨率128*160"
    config LCD_ST7735_128X128
        bool "ST7735, 分辨率128*128"
    config LCD_ST7796_320X480
        bool "ST7796, 分辨率320*480 IPS"
    config LCD_ST7796_320X480_NO_IPS
        bool "ST7796, 分辨率320*480, 非IPS"
    config LCD_ILI9341_240X320
        bool "ILI9341, 分辨率240*320"
    config LCD_ILI9341_240X320_NO_IPS
        bool "ILI9341, 分辨率240*320, 非IPS"
    config LCD_TYPE_800_1280_10_1_INCH
        bool "Waveshare 101M-8001280-IPS-CT-K Display"
    config LCD_TYPE_800_1280_10_1_INCH_A
        bool "Waveshare 10.1-DSI-TOUCH-A Display"
    config LCD_GC9A01_240X240
        bool "GC9A01, 分辨率240*240, 圆屏"
    config LCD_GC9A01_160X160
        bool "GC9A01, 分辨率160*160, 0.71寸"
    config LCD_CUSTOM
        bool "自定义屏幕参数"
endchoice

choice DISPLAY_ESP32S3_KORVO2_V3
    depends on BOARD_TYPE_ESP32S3_KORVO2_V3
    prompt "ESP32S3_KORVO2_V3 LCD Type"
    default LCD_ST7789
    help
        屏幕类型选择
    config LCD_ST7789
        bool "ST7789, 分辨率240*280"
    config LCD_ILI9341
        bool "ILI9341, 分辨率240*320"
endchoice


config USE_EYE_STYLE_VB6824
    bool "Use VB6824"
    default n
    help
        VB6824

choice CONNECTION_TYPE
    prompt "WiFi Connection Type"
    default CONNECTION_TYPE_BLE
    help
        Select the WiFi connection type

    config CONNECTION_TYPE_BLE
        bool "WiFi with BLE"
        help
            Connect to WiFi using BLE provisioning

    config CONNECTION_TYPE_AP
        bool "WiFi with AP"
        help
            Connect to WiFi using Access Point mode
endchoice

config USE_GIZWITS_MQTT
    bool "Enable Gizwits MQTT"
    default y
    help
        使用 Gizwits MQTT 协议


config USE_WECHAT_MESSAGE_STYLE
    bool "Enable WeChat Message Style"
    default n
    help
        使用微信聊天界面风格


config USE_ESP_WAKE_WORD
    bool "Enable Wake Word Detection (without AFE)"
    default n
    depends on IDF_TARGET_ESP32C3 || IDF_TARGET_ESP32C5 || IDF_TARGET_ESP32C6 || (IDF_TARGET_ESP32 && SPIRAM)
    help
        支持 ESP32 C3、ESP32 C5 与 ESP32 C6，增加ESP32支持（需要开启PSRAM）

config USE_AFE_WAKE_WORD
    bool "Enable Wake Word Detection (AFE)"
    default y
    depends on (IDF_TARGET_ESP32S3 || IDF_TARGET_ESP32P4) && SPIRAM
    help
        需要 ESP32 S3 与 PSRAM 支持

config USE_CUSTOM_WAKE_WORD
    bool "Enable Custom Wake Word Detection"
    default n
    depends on (IDF_TARGET_ESP32S3 || IDF_TARGET_ESP32P4) && SPIRAM && (!USE_AFE_WAKE_WORD)
    help
        需要 ESP32 S3 与 PSRAM 支持
        
config CUSTOM_WAKE_WORD
    string "Custom Wake Word"
    default "xiao tu dou"
    depends on USE_CUSTOM_WAKE_WORD
    help
        自定义唤醒词，中文用拼音表示，每个字之间用空格隔开

config USE_DEVICE_AEC
    bool "Enable Device-Side AEC"
    default n
    help
        因为性能不够，不建议和微信聊天界面风格同时开启

config USE_AUDIO_PROCESSOR
    bool "Enable Audio Noise Reduction"
    default y
    depends on (IDF_TARGET_ESP32S3 || IDF_TARGET_ESP32P4) && SPIRAM
    help
        需要 ESP32 S3 与 PSRAM 支持
        
config USE_SERVER_AEC
    bool "Enable Server-Side AEC"
    default n
    depends on USE_AUDIO_PROCESSOR
    help
        启用服务器端 AEC，需要服务器支持


config USE_AUDIO_DEBUGGER
    bool "Enable Audio Debugger"
    default n
    help
        启用音频调试功能，通过UDP发送音频数据


config AUDIO_DEBUG_UDP_SERVER
    string "Audio Debug UDP Server Address"
    default "192.168.2.100:8000"
    depends on USE_AUDIO_DEBUGGER
    help
        UDP服务器地址，格式: IP:PORT，用于接收音频调试数据

config RECEIVE_CUSTOM_MESSAGE
    bool "Enable Custom Message Reception"
    default n
    help
        启用接收自定义消息功能，允许设备接收来自服务器的自定义消息（最好通过 MQTT 协议）


choice IOT_PROTOCOL
    prompt "IoT Protocol"
    default IOT_PROTOCOL_XIAOZHI
    help
        IoT 协议，用于获取设备状态与发送控制指令
    config IOT_PROTOCOL_MCP
        bool "MCP协议 2024-11-05"
    config IOT_PROTOCOL_XIAOZHI
        bool "小智IoT协议 1.0"
endchoice

endmenu
```

## main/boards/TT视频转bin/gizwits_rtc_esp32-releases-v1.3.6-socket-tt-peter/main/Kconfig.projbuild
```kconfig
menu "Atom Config"

    choice AUDIO_DECODER_SUPPORT
        prompt "Audio Decoder"
        default AUDIO_SUPPORT_PCM_DECODER
    
    config AUDIO_SUPPORT_G711A_DECODER
        bool "AUDIUO-G711-DECODER"
    
    config AUDIO_SUPPORT_OPUS_DECODER
        bool "AUDIO-OPUS-DECODER"
    
    config AUDIO_SUPPORT_AAC_DECODER
        bool "AUDIO-AAC-DECODER"
    config AUDIO_SUPPORT_PCM_DECODER
        bool "AUDIO-PCM-DECODER"
    endchoice
    
    choice ACTIVED_MODE_SUPPORT
        prompt "Activated Mode"
        default ACTIVED_MODE_BUTTON
    
    config ACTIVED_MODE_SERVER_VAD
        bool "ACTIVED-MODE-SERVER-VAD"
    
    config ACTIVED_MODE_BUTTON
        bool "ACTIVED_MODE_BUTTON"

    config ACTIVED_MODE_BUTTON_AND_WAKEUP
        bool "ACTIVED_MODE_BUTTON_AND_WAKEUP"
    
    config ACTIVED_MODE_SERVER_VAD_AND_WAKEUP
        bool "ACTIVED_MODE_SERVER_VAD_AND_WAKEUP"
    
    endchoice

    choice TT_MUSIC_HARDWARE_VERION
        prompt "TT Music Hardware Version"
        default TT_MUSIC_HW_1V5
    
    config TT_MUSIC_HW_1V5
        bool "TT Music Hardware V1.5"
    
    config TT_MUSIC_HW_1V3
        bool "TT Music Hardware V1.3 or V1.2BX"
    
    endchoice

    choice TEST_MODE
        prompt "Test Mode"
        default TEST_MODE_NONE
    
    config TEST_MODE_VOICE
        bool "TEST-MODE-VOICE"
    
    config TEST_MODE_SERVER_VAD
        bool "TEST-MODE-SERVER-VAD"
    
    config TEST_MODE_NONE
        bool "TEST-MODE-NONE"
    
    endchoice

    choice FACTORY_TEST_MODE
        prompt "Factory Test Mode"
        default FACTORY_TEST_MODE_ENABLE
    
    config FACTORY_TEST_MODE_ENABLE
        bool "Factory Test Mode Enable"
    
    config FACTORY_TEST_MODE_DISABLE
        bool "Factory Test Mode Disable"
        
    endchoice

    config SERVO_SUPPORT
        bool "Enable servo motor support"
        default n
        help
            Enable this option to support servo motor control functionality.

    config SUPPORT_HEART_BEAT
        bool "Enable heart beat support"
        default n
        help
            Enable this option to support servo motor control functionality.
        

    choice AUDIO_WAKE_UP_SUPPORT
        prompt "Select wake up word"
        default WAKE_UP_HAIMIANBAOBAO
        help
            Select which wake up word to use.

        config WAKE_UP_HAIMIANBAOBAO
            bool "Hai Mian Bao Bao"
            help
                Use "Hai Mian Bao Bao" as wake up word
        config WAKE_UP_MOFANGMOFANG
            bool "Mo Fang Mo Fang"
            help
                Use "Mo Fang Mo Fang" as wake up word
        config WAKE_UP_XIAOZHIXIAOZHI
            bool "Xiao Zhi Xiao Zhi"
            help
                Use "Xiao Zhi Xiao Zhi" as wake up word
        config WAKE_UP_XIAOYUNXIAOYUN
            bool "Xiao Yun Xiao Yun"
            help
                Use "Xiao Yun Xiao Yun" as wake up word             
        config WAKE_UP_NONE
            bool "NONE"
            help
                Use "NONE" as wake up word
    endchoice

    choice TRACE_LOG
        prompt "Trace log"
        default TRACE_LOG_DISABLE
    
    config TRACE_LOG_DISABLE
        bool "Disable trace log"
    
    config TRACE_LOG_ENABLE
        bool "Enable trace log"

    endchoice


endmenu
```
